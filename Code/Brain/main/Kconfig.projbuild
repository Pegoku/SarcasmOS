## Code/Brain/main/Kconfig.projbuild
```kconfig
menu "SarcasmOS Brain"

config SARCASMOS_WIFI_SSID
    string "Wi-Fi SSID"
    default ""

config SARCASMOS_WIFI_PASSWORD
    string "Wi-Fi password"
    default ""

config SARCASMOS_AI_TOKEN
    string "Shared AI provider token"
    default ""

config SARCASMOS_LLM_TOKEN
    string "LLM token (falls back to shared token)"
    default ""

config SARCASMOS_REPLICATE_TOKEN
    string "STT/TTS token (falls back to shared token)"
    default ""

config SARCASMOS_LLM_URL
    string "OpenAI-compatible LLM base URL"
    default "https://ai.hackclub.com/proxy/v1"

config SARCASMOS_REPLICATE_URL
    string "Replicate-compatible base URL"
    default "https://ai.hackclub.com/proxy/v1/replicate"

config SARCASMOS_LLM_MODEL
    string "LLM model"
    default "~anthropic/claude-sonnet-latest"

config SARCASMOS_STT_MODEL
    string "Replicate STT model or version"
    default "vaibhavs10/incredibly-fast-whisper:3ab86df6c8f54c11309d4d1f930ac292bad43ace52d10c80d87eb258b3c9f79c"

config SARCASMOS_TTS_MODEL
    string "Replicate TTS model"
    default "minimax/speech-2.8-turbo"

config SARCASMOS_VOICE_ID
    string "MiniMax Bender voice ID"
    default ""

config SARCASMOS_GOOGLE_CALENDAR_TOKEN
    string "Google Calendar OAuth access token"
    default ""

config SARCASMOS_TIMEZONE
    string "IANA timezone"
    default "Europe/Madrid"

config SARCASMOS_WAKE_PHRASE
    string "Wake phrase"
    default "oye bender"

config SARCASMOS_WAKE_ENABLED
    bool "Enable wake phrase listener at boot"
    default n

config SARCASMOS_LISTEN_SILENCE_MS
    int "Silence that finishes a voice request (ms)"
    range 500 15000
    default 5000

config SARCASMOS_VAD_THRESHOLD
    int "Microphone voice activity threshold"
    range 1 65535
    default 1200

config SARCASMOS_ENABLE_WIFI
    bool "Enable Wi-Fi station at boot"
    default y

config SARCASMOS_ENABLE_ETHERNET
    bool "Enable W5500 Ethernet at boot"
    default n

config SARCASMOS_MOUTH_ESPNOW
    bool "Enable ESP-NOW mouth controller"
    default y

config SARCASMOS_MOUTH_MAC
    string "ESP-NOW mouth station MAC"
    depends on SARCASMOS_MOUTH_ESPNOW
    default ""

config SARCASMOS_ESPNOW_CHANNEL
    int "ESP-NOW channel when not connected to Wi-Fi"
    depends on SARCASMOS_MOUTH_ESPNOW
    range 1 14
    default 1

config SARCASMOS_ESPNOW_ACK_TIMEOUT_MS
    int "ESP-NOW mouth acknowledgement timeout (ms)"
    depends on SARCASMOS_MOUTH_ESPNOW
    range 10 2000
    default 100

config SARCASMOS_ESPNOW_RETRIES
    int "ESP-NOW mouth command attempts"
    depends on SARCASMOS_MOUTH_ESPNOW
    range 1 10
    default 3

config SARCASMOS_EYE_POLL_INTERVAL_MS
    int "Eye transition status poll interval (ms)"
    range 10 500
    default 20

config SARCASMOS_EYE_BARRIER_TIMEOUT_MS
    int "Eye transition barrier timeout (ms)"
    range 100 10000
    default 2500

config SARCASMOS_NO_EYE_TIMEOUT_MS
    int "No-eye degraded presence timeout (ms)"
    range 20 2000
    default 250

config SARCASMOS_FACE_TRANSITION_MS
    int "Mouth visual transition duration (ms)"
    range 40 1000
    default 200

config SARCASMOS_W5500_SPI_FREQ_HZ
    int "W5500 SPI frequency"
    default 20000000

config SARCASMOS_I2C_FREQ_HZ
    int "I2C bus frequency"
    default 400000

config SARCASMOS_HTTP_PORT
    int "HTTP API port"
    default 80

endmenu
```

## Code/Brain/sdkconfig.defaults
```kconfig
CONFIG_IDF_TARGET="esp32s3"
CONFIG_ESP_MAIN_TASK_STACK_SIZE=8192
CONFIG_ESP_SYSTEM_EVENT_TASK_STACK_SIZE=4096
CONFIG_ESP_WIFI_ENABLED=y
CONFIG_FREERTOS_USE_TRACE_FACILITY=y
CONFIG_ESPTOOLPY_FLASHSIZE_16MB=y
CONFIG_ESPTOOLPY_FLASHSIZE="16MB"
CONFIG_PARTITION_TABLE_CUSTOM=y
CONFIG_PARTITION_TABLE_CUSTOM_FILENAME="partitions.csv"
CONFIG_HTTPD_WS_SUPPORT=y
CONFIG_HTTPD_WS_POST_HANDSHAKE_CB_SUPPORT=y
CONFIG_MBEDTLS_CERTIFICATE_BUNDLE_CROSS_SIGNED_VERIFY=y
```

## Code/Brain/self_test/main/Kconfig.projbuild
```kconfig
menu "SarcasmOS Brain self-test"

config BRAIN_SELF_TEST_WIFI
    bool "Enable Wi-Fi scan and connection tests"
    default y

config BRAIN_SELF_TEST_WIFI_TIMEOUT_MS
    int "Wi-Fi connection timeout (ms)"
    depends on BRAIN_SELF_TEST_WIFI
    range 1000 60000
    default 15000

config BRAIN_SELF_TEST_MOUTH_ESPNOW
    bool "Test ESP-NOW mouth controller"
    default y

config BRAIN_SELF_TEST_MOUTH_MAC
    string "ESP-NOW mouth station MAC"
    depends on BRAIN_SELF_TEST_MOUTH_ESPNOW
    default ""

config BRAIN_SELF_TEST_ESPNOW_CHANNEL
    int "ESP-NOW channel when not connected to Wi-Fi"
    depends on BRAIN_SELF_TEST_MOUTH_ESPNOW
    range 1 14
    default 1

config BRAIN_SELF_TEST_ESPNOW_ACK_TIMEOUT_MS
    int "ESP-NOW mouth acknowledgement timeout (ms)"
    depends on BRAIN_SELF_TEST_MOUTH_ESPNOW
    range 10 2000
    default 100

config BRAIN_SELF_TEST_ESPNOW_RETRIES
    int "ESP-NOW mouth command attempts"
    depends on BRAIN_SELF_TEST_MOUTH_ESPNOW
    range 1 10
    default 3

config BRAIN_SELF_TEST_W5500
    bool "Read the W5500 version register"
    default y

config BRAIN_SELF_TEST_AUDIO
    bool "Test I2S microphone and speaker data path"
    default y

config BRAIN_SELF_TEST_SPEAKER_TONE
    bool "Play a short speaker test tone"
    depends on BRAIN_SELF_TEST_AUDIO
    default y

config BRAIN_SELF_TEST_I2C_FREQ_HZ
    int "I2C scan frequency"
    range 10000 400000
    default 100000

endmenu
```
